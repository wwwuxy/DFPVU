## Kconfig
```kconfig
mainmenu "Test File Config"

menu "RESNET_TEST"
    choice
        prompt "Posit<32, 2>"
        default RESNET_ADD_P32
        depends on !SAMPLE_TEST  # 新增依赖：仅在SAMPLE_TEST未启用时可见
        help
            Select one of the ResNet operations for the test.

    config RESNET_ADD_P32
        bool "resnet_add_p32_test"
        default n
        help
            Enable ResNet addition test.

    config RESNET_SUB_P32
        bool "resnet_sub_p32_test"
        default n
        help
            Enable ResNet subtraction test.

    config RESNET_MUL_P32
        bool "resnet_mul_p32_test"
        default n
        help
            Enable ResNet multiplication test.

    config RESNET_DIV_P32
        bool "resnet_div_p32_test"
        default n
        help
            Enable ResNet division test.

    config RESNET_DOT_P32
        bool "resnet_dot_p32_test"
        default n
        help
            Enable ResNet dot product test. 

    config RESNET_FP32_TO_POSIT32
        bool "resnet_fp32_to_posit32_test"
        default n
        help
            Enable IEEE-754 FP32 to Posit32 conversion test.
            
    config RESNET_POSIT32_TO_FP32
        bool "resnet_posit32_to_fp32_test"
        default n
        help
            Enable Posit32 to IEEE-754 FP32 conversion test.

    config RESNET_POSIT32_TO_FP4
        bool "resnet_posit32_to_fp4_precision_batch_test"
        default n
        help
            Enable Posit32 to FP4 batch conversion and precision-loss report.

    config RESNET_POSIT32_TO_FP8
        bool "resnet_posit32_to_fp8_precision_batch_test"
        default n
        help
            Enable Posit32 to FP8 batch conversion and precision-loss report.

    config RESNET_POSIT32_TO_FP16
        bool "resnet_posit32_to_fp16_precision_batch_test"
        default n
        help
            Enable Posit32 to FP16 batch conversion and precision-loss report.
            
    config RESNET_GREATER_P32
        bool "resnet_greater_p32_test"
        default n
        help
            Enable Posit32 greater comparison test.

    config RESNET_LESS_P32
        bool "resnet_less_p32_test"
        default n
        help
            Enable Posit32 less comparison test.

    config RESNET_TRUNCATE_P32
        bool "resnet_truncate_p32_test"
        default n
        help
            Enable Posit32 to Int32 truncation test.

    config PVU_PROTOCOL_REGRESSION
        bool "pvu_protocol_exact_reference_regression"
        default n
        help
            Run the operation-complete, exact SoftPosit reference regression.
            This is the baseline driver for the tagged ready/valid protocol.

    config PVU_MAC_REGRESSION
        bool "pvu_mac_exact_reference_regression"
        default n
        help
            Run the Posit32 MAC regression: c + sum(a[i] * b[i]).
            Uses the existing tagged ready/valid protocol and SoftPosit oracle.

    config LLM_P32_MAC_WORKLOAD
        bool "llm_p32_mac_workload"
        default n
        help
            Replay exported LLM pre-bias linear-output elements through the
            Posit32 MAC datapath and report Verilator workload numerical loss
            and utilization metrics. The trace profile selects the intended
            model family; model weights are never downloaded by make.

    config LLM_P32_CONVERSION_WORKLOAD
        bool "llm_p32_conversion_workload"
        default n
        help
            Replay exported LLM tensor values through both directions of the
            Posit32 and IEEE FP32 conversion datapath. The runner reports
            conversion throughput, exact SoftPosit conformance, and FP32
            round-trip loss for the selected trace tensor source.


    config LLM_P32_TO_P16_WORKLOAD
        bool "llm_p32_to_p16_workload"
        default n
        help
            Replay captured LLM activation, weight, or pre-bias output values
            through Posit32-to-Posit16 conversion. Raw output is checked
            exactly against SoftPosit; P16 reconstructed to P32 statistics are
            observational only and do not claim end-to-end model quantization.

    config LLM_P32_DOT_WORKLOAD
        bool "llm_p32_dot_workload"
        default n
        help
            Replay four-element input and projection-weight vector pairs from
            exported LLM linear layers through the Posit32 Dot datapath. The
            runner reports exact SoftPosit conformance, Dot throughput, and
            observational FP32 numerical loss.

    config LLM_P32_MUL_WORKLOAD
        bool "llm_p32_mul_workload"
        default n
        help
            Replay four-element input and projection-weight vector pairs from
            exported LLM linear layers through the Posit32 vector multiply
            datapath. Each lane is checked independently against SoftPosit,
            and the runner reports vector and element throughput plus
            observational P32-versus-FP32 multiplication loss.

    config LLM_P32_TO_INT_WORKLOAD
        bool "llm_p32_to_int_workload"
        default n
        help
            Replay actual LLM activation, weight, or linear-output values
            through the Posit32-to-Int32 datapath. The runner reports exact
            SoftPosit conformance, conversion throughput, saturation count,
            and integerization error relative to the source FP32 values.

    config LLM_P32_ADD_WORKLOAD
        bool "llm_p32_add_workload"
        default n
        help
            Replay actual same-shape binary tensor additions captured during
            local LLM forward execution through the Posit32 vector Add
            datapath. The runner checks every active lane against SoftPosit
            and reports ready/valid throughput plus FP32 observation metrics.

    config MATRIX_GEMM_P32_BENCHMARK
        bool "matrix_gemm_p32_throughput_benchmark"
        default n
        help
            Run one deterministic Posit32 GEMM MxK times KxN benchmark.
            The runner reports cycle-level throughput and verifies every
            output against the SoftPosit MAC recurrence.

    endchoice

if MATRIX_GEMM_P32_BENCHMARK || LLM_P32_MAC_WORKLOAD

choice
    prompt "P32 MNK test shape"
    default MATRIX_GEMM_P32_PRESET_TAIL_K2
    help
        Select the M, N, K dimensions. The matrix benchmark uses this as its
        full GEMM shape; an LLM workload uses it as a real trace tile.

config MATRIX_GEMM_P32_PRESET_TAIL_K1
    bool "Tail K=1: M=2, N=3, K=1"

config MATRIX_GEMM_P32_PRESET_TAIL_K2
    bool "Tail K=2: M=2, N=3, K=2"

config MATRIX_GEMM_P32_PRESET_TAIL_K3
    bool "Tail K=3: M=2, N=3, K=3"

config MATRIX_GEMM_P32_PRESET_TAIL_K4
    bool "Full lane K=4: M=2, N=3, K=4"

config MATRIX_GEMM_P32_PRESET_TAIL_K5
    bool "Tail K=5: M=2, N=3, K=5"

config MATRIX_GEMM_P32_PRESET_SQUARE_16
    bool "Square small: M=16, N=16, K=16"

config MATRIX_GEMM_P32_PRESET_SQUARE_32_K63
    bool "Square tail: M=32, N=32, K=63"

config MATRIX_GEMM_P32_PRESET_SQUARE_32_K64
    bool "Square full lane: M=32, N=32, K=64"

config MATRIX_GEMM_P32_PRESET_SQUARE_32_K65
    bool "Square tail: M=32, N=32, K=65"

config MATRIX_GEMM_P32_PRESET_GEMV_ROW
    bool "GEMV row: M=1, N=128, K=256"

config MATRIX_GEMM_P32_PRESET_GEMV_COLUMN
    bool "GEMV column: M=128, N=1, K=256"

config MATRIX_GEMM_P32_PRESET_WIDE
    bool "Wide: M=16, N=128, K=64"

config MATRIX_GEMM_P32_PRESET_TALL
    bool "Tall: M=128, N=16, K=64"

config MATRIX_GEMM_P32_PRESET_CUBE_64
    bool "Cube medium: M=64, N=64, K=64"

config MATRIX_GEMM_P32_PRESET_CUBE_128
    bool "Cube large: M=128, N=128, K=128"

endchoice

config MATRIX_GEMM_P32_M
    int
    range 1 4096
    default 2 if MATRIX_GEMM_P32_PRESET_TAIL_K1 || MATRIX_GEMM_P32_PRESET_TAIL_K2 || MATRIX_GEMM_P32_PRESET_TAIL_K3 || MATRIX_GEMM_P32_PRESET_TAIL_K4 || MATRIX_GEMM_P32_PRESET_TAIL_K5
    default 16 if MATRIX_GEMM_P32_PRESET_SQUARE_16 || MATRIX_GEMM_P32_PRESET_WIDE
    default 32 if MATRIX_GEMM_P32_PRESET_SQUARE_32_K63 || MATRIX_GEMM_P32_PRESET_SQUARE_32_K64 || MATRIX_GEMM_P32_PRESET_SQUARE_32_K65
    default 1 if MATRIX_GEMM_P32_PRESET_GEMV_ROW
    default 128 if MATRIX_GEMM_P32_PRESET_GEMV_COLUMN || MATRIX_GEMM_P32_PRESET_TALL || MATRIX_GEMM_P32_PRESET_CUBE_128
    default 64 if MATRIX_GEMM_P32_PRESET_CUBE_64

config MATRIX_GEMM_P32_N
    int
    range 1 4096
    default 3 if MATRIX_GEMM_P32_PRESET_TAIL_K1 || MATRIX_GEMM_P32_PRESET_TAIL_K2 || MATRIX_GEMM_P32_PRESET_TAIL_K3 || MATRIX_GEMM_P32_PRESET_TAIL_K4 || MATRIX_GEMM_P32_PRESET_TAIL_K5
    default 16 if MATRIX_GEMM_P32_PRESET_SQUARE_16 || MATRIX_GEMM_P32_PRESET_TALL
    default 32 if MATRIX_GEMM_P32_PRESET_SQUARE_32_K63 || MATRIX_GEMM_P32_PRESET_SQUARE_32_K64 || MATRIX_GEMM_P32_PRESET_SQUARE_32_K65
    default 128 if MATRIX_GEMM_P32_PRESET_GEMV_ROW || MATRIX_GEMM_P32_PRESET_WIDE || MATRIX_GEMM_P32_PRESET_CUBE_128
    default 1 if MATRIX_GEMM_P32_PRESET_GEMV_COLUMN
    default 64 if MATRIX_GEMM_P32_PRESET_CUBE_64

config MATRIX_GEMM_P32_K
    int
    range 1 4096
    default 1 if MATRIX_GEMM_P32_PRESET_TAIL_K1
    default 2 if MATRIX_GEMM_P32_PRESET_TAIL_K2
    default 3 if MATRIX_GEMM_P32_PRESET_TAIL_K3
    default 4 if MATRIX_GEMM_P32_PRESET_TAIL_K4
    default 5 if MATRIX_GEMM_P32_PRESET_TAIL_K5
    default 16 if MATRIX_GEMM_P32_PRESET_SQUARE_16
    default 63 if MATRIX_GEMM_P32_PRESET_SQUARE_32_K63
    default 64 if MATRIX_GEMM_P32_PRESET_SQUARE_32_K64
    default 65 if MATRIX_GEMM_P32_PRESET_SQUARE_32_K65
    default 256 if MATRIX_GEMM_P32_PRESET_GEMV_ROW || MATRIX_GEMM_P32_PRESET_GEMV_COLUMN
    default 64 if MATRIX_GEMM_P32_PRESET_WIDE || MATRIX_GEMM_P32_PRESET_TALL || MATRIX_GEMM_P32_PRESET_CUBE_64
    default 128 if MATRIX_GEMM_P32_PRESET_CUBE_128

endif

if LLM_P32_MAC_WORKLOAD || LLM_P32_CONVERSION_WORKLOAD || LLM_P32_TO_P16_WORKLOAD || LLM_P32_DOT_WORKLOAD || LLM_P32_MUL_WORKLOAD || LLM_P32_TO_INT_WORKLOAD || LLM_P32_ADD_WORKLOAD

choice
    prompt "LLM P32 trace profile"
    default LLM_P32_PROFILE_QWEN3_0_6B

config LLM_P32_PROFILE_QWEN3_0_6B
    bool "Qwen3-0.6B (dense baseline)"

config LLM_P32_PROFILE_GEMMA3_1B
    bool "Gemma 3 1B (dense)"

config LLM_P32_PROFILE_PHI4_MINI
    bool "Phi-4-mini-instruct (dense)"

endchoice

choice
    prompt "LLM model and trace path mode"
    default LLM_P32_PATH_MODE_PROFILE_DEFAULTS
    help
        Profile defaults keep the model and trace roots synchronized when
        switching among Qwen3, Gemma, and Phi. Custom paths are opt-in.

config LLM_P32_PATH_MODE_PROFILE_DEFAULTS
    bool "Use paths provided by the selected profile"

config LLM_P32_PATH_MODE_CUSTOM
    bool "Use custom model and trace paths"

endchoice

if LLM_P32_PATH_MODE_CUSTOM

config LLM_P32_MODEL_DIR
    string "Custom LLM local model directory"
    default ""
    help
        Override the selected profile's standard local model directory.

if ! LLM_P32_ADD_WORKLOAD

config LLM_P32_MAC_TRACE_DIR
    string "Custom LLM P32 trace directory"
    default ""
    help
        Override the selected profile's standard linear trace directory.

endif

endif

config LLM_P32_AUTO_EXPORT_TRACE
    bool "Automatically export a missing LLM trace"
    default y
    help
        On the first make run, export a layer-0 attention projection from the
        selected local model into the trace directory. Export is offline and
        uses 128 tokens, covering every supplied MNK preset. Existing traces
        are not overwritten. Disable this to require a manually exported
        trace instead.

if LLM_P32_CONVERSION_WORKLOAD || LLM_P32_TO_P16_WORKLOAD

choice
    prompt "LLM conversion trace tensor"
    default LLM_P32_CONVERSION_TENSOR_INPUT
    help
        Select the real tensor distribution replayed by the op=7 conversion
        workload. Input and output are activations; weight is the projection
        parameter distribution.

config LLM_P32_CONVERSION_TENSOR_INPUT
    bool "Layer input activation"

config LLM_P32_CONVERSION_TENSOR_WEIGHT
    bool "Projection weight"

config LLM_P32_CONVERSION_TENSOR_OUTPUT
    bool "Linear output activation"

endchoice

config LLM_P32_CONVERSION_TENSOR
    string
    default "input" if LLM_P32_CONVERSION_TENSOR_INPUT
    default "weight" if LLM_P32_CONVERSION_TENSOR_WEIGHT
    default "output" if LLM_P32_CONVERSION_TENSOR_OUTPUT

choice
    prompt "LLM conversion samples per module"
    default LLM_P32_CONVERSION_SAMPLES_256
    help
        Select a deterministic, evenly spaced number of scalar elements from
        each exported module tensor. A tensor smaller than the selection is
        replayed in full without duplicate samples.

config LLM_P32_CONVERSION_SAMPLES_256
    bool "256 elements"

config LLM_P32_CONVERSION_SAMPLES_1024
    bool "1024 elements"

config LLM_P32_CONVERSION_SAMPLES_4096
    bool "4096 elements"

endchoice


config LLM_P32_CONVERSION_SAMPLE_COUNT
    int
    range 1 65536
    default 256 if LLM_P32_CONVERSION_SAMPLES_256
    default 1024 if LLM_P32_CONVERSION_SAMPLES_1024
    default 4096 if LLM_P32_CONVERSION_SAMPLES_4096

endif

if LLM_P32_DOT_WORKLOAD

choice
    prompt "LLM Dot samples per module"
    default LLM_P32_DOT_SAMPLES_256
    help
        Select a deterministic, evenly spaced number of four-element
        input-times-weight Dot vectors from each exported linear module.
        A module with fewer vectors is replayed in full without duplicates.

config LLM_P32_DOT_SAMPLES_256
    bool "256 Dot vectors"

config LLM_P32_DOT_SAMPLES_1024
    bool "1024 Dot vectors"

config LLM_P32_DOT_SAMPLES_4096
    bool "4096 Dot vectors"

endchoice

config LLM_P32_DOT_SAMPLE_COUNT
    int
    range 1 65536
    default 256 if LLM_P32_DOT_SAMPLES_256
    default 1024 if LLM_P32_DOT_SAMPLES_1024
    default 4096 if LLM_P32_DOT_SAMPLES_4096

endif
if LLM_P32_MUL_WORKLOAD

choice
    prompt "LLM Multiply samples per module"
    default LLM_P32_MUL_SAMPLES_256
    help
        Select a deterministic, evenly spaced number of four-element
        input-times-weight vectors from each exported linear module. Each
        vector becomes one four-lane P32 multiply request; a smaller module
        is replayed in full without duplicate samples.

config LLM_P32_MUL_SAMPLES_256
    bool "256 Multiply vectors"

config LLM_P32_MUL_SAMPLES_1024
    bool "1024 Multiply vectors"

config LLM_P32_MUL_SAMPLES_4096
    bool "4096 Multiply vectors"

endchoice

config LLM_P32_MUL_SAMPLE_COUNT
    int
    range 1 65536
    default 256 if LLM_P32_MUL_SAMPLES_256
    default 1024 if LLM_P32_MUL_SAMPLES_1024
    default 4096 if LLM_P32_MUL_SAMPLES_4096

endif

if LLM_P32_TO_INT_WORKLOAD

choice
    prompt "LLM P32-to-Int trace tensor"
    default LLM_P32_TO_INT_TENSOR_INPUT
    help
        Select the real LLM tensor distribution converted from Posit32 to
        Int32. Input and output are activations; weight is the projection
        parameter distribution.

config LLM_P32_TO_INT_TENSOR_INPUT
    bool "Layer input activation"

config LLM_P32_TO_INT_TENSOR_WEIGHT
    bool "Projection weight"

config LLM_P32_TO_INT_TENSOR_OUTPUT
    bool "Linear output activation"

endchoice

config LLM_P32_TO_INT_TENSOR
    string
    default "input" if LLM_P32_TO_INT_TENSOR_INPUT
    default "weight" if LLM_P32_TO_INT_TENSOR_WEIGHT
    default "output" if LLM_P32_TO_INT_TENSOR_OUTPUT

choice
    prompt "LLM P32-to-Int samples per module"
    default LLM_P32_TO_INT_SAMPLES_256
    help
        Select a deterministic, evenly spaced number of scalar elements from
        each exported module tensor. A tensor smaller than the selection is
        replayed in full without duplicate samples.

config LLM_P32_TO_INT_SAMPLES_256
    bool "256 elements"

config LLM_P32_TO_INT_SAMPLES_1024
    bool "1024 elements"

config LLM_P32_TO_INT_SAMPLES_4096
    bool "4096 elements"

endchoice

config LLM_P32_TO_INT_SAMPLE_COUNT
    int
    range 1 65536
    default 256 if LLM_P32_TO_INT_SAMPLES_256
    default 1024 if LLM_P32_TO_INT_SAMPLES_1024
    default 4096 if LLM_P32_TO_INT_SAMPLES_4096

endif

if LLM_P32_ADD_WORKLOAD

if LLM_P32_PATH_MODE_CUSTOM

config LLM_P32_ADD_TRACE_DIR
    string "Custom LLM P32 Add trace directory"
    default ""
    help
        Override the selected profile's dedicated Add trace directory.

endif

choice
    prompt "LLM P32 Add elements per captured operation"
    default LLM_P32_ADD_SAMPLES_256
    help
        Select a deterministic, evenly spaced number of scalar Add elements
        from every captured real model-forward Add operation.

config LLM_P32_ADD_SAMPLES_256
    bool "256 Add elements"

config LLM_P32_ADD_SAMPLES_1024
    bool "1024 Add elements"

config LLM_P32_ADD_SAMPLES_4096
    bool "4096 Add elements"

endchoice

config LLM_P32_ADD_SAMPLE_COUNT
    int
    range 1 65536
    default 256 if LLM_P32_ADD_SAMPLES_256
    default 1024 if LLM_P32_ADD_SAMPLES_1024
    default 4096 if LLM_P32_ADD_SAMPLES_4096

endif


endif

endmenu

config SAMPLE_TEST
    bool "manually_sample_test"
    default n
```
