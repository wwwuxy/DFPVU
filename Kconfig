## Kconfig.orig
```kconfig
mainmenu "Test File Config"

menu "RESNET_TEST"
    choice
        prompt "Posit<32, 2>"
        default RESNET_ADD_P32
        depends on !SAMPLE_TEST  # 新增依赖：仅在SAMPLE_TEST未启用时可见
        help
            Select one of the ResNet operations for the test.

    config RESNET_ADD_P32
        bool "resnet_add_p32_test"
        default n
        help
            Enable ResNet addition test.

    config RESNET_SUB_P32
        bool "resnet_sub_p32_test"
        default n
        help
            Enable ResNet subtraction test.

    config RESNET_MUL_P32
        bool "resnet_mul_p32_test"
        default n
        help
            Enable ResNet multiplication test.

    config RESNET_DIV_P32
        bool "resnet_div_p32_test"
        default n
        help
            Enable ResNet division test.

    config RESNET_DOT_P32
        bool "resnet_dot_p32_test"
        default n
        help
            Enable ResNet dot product test. 

    config RESNET_FP32_TO_POSIT32
        bool "resnet_fp32_to_posit32_test"
        default n
        help
            Enable IEEE-754 FP32 to Posit32 conversion test.
            
    config RESNET_POSIT32_TO_FP32
        bool "resnet_posit32_to_fp32_test"
        default n
        help
            Enable Posit32 to IEEE-754 FP32 conversion test.

    config RESNET_POSIT32_TO_FP4
        bool "resnet_posit32_to_fp4_precision_batch_test"
        default n
        help
            Enable Posit32 to FP4 batch conversion and precision-loss report.

    config RESNET_POSIT32_TO_FP8
        bool "resnet_posit32_to_fp8_precision_batch_test"
        default n
        help
            Enable Posit32 to FP8 batch conversion and precision-loss report.

    config RESNET_POSIT32_TO_FP16
        bool "resnet_posit32_to_fp16_precision_batch_test"
        default n
        help
            Enable Posit32 to FP16 batch conversion and precision-loss report.
            
    config RESNET_GREATER_P32
        bool "resnet_greater_p32_test"
        default n
        help
            Enable Posit32 greater comparison test.

    config RESNET_LESS_P32
        bool "resnet_less_p32_test"
        default n
        help
            Enable Posit32 less comparison test.

    config RESNET_TRUNCATE_P32
        bool "resnet_truncate_p32_test"
        default n
        help
            Enable Posit32 to Int32 truncation test.

    config PVU_PROTOCOL_REGRESSION
        bool "pvu_protocol_exact_reference_regression"
        default n
        help
            Run the operation-complete, exact SoftPosit reference regression.
            This is the baseline driver for the tagged ready/valid protocol.

    config PVU_MAC_REGRESSION
        bool "pvu_mac_exact_reference_regression"
        default n
        help
            Run the Posit32 MAC regression: c + sum(a[i] * b[i]).
            Uses the existing tagged ready/valid protocol and SoftPosit oracle.

    config LLM_P32_MAC_WORKLOAD
        bool "llm_p32_mac_workload"
        default n
        help
            Replay exported LLM pre-bias linear-output elements through the
            Posit32 MAC datapath and report Verilator workload numerical loss
            and utilization metrics. The trace profile selects the intended
            model family; model weights are never downloaded by make.

    config MATRIX_GEMM_P32_BENCHMARK
        bool "matrix_gemm_p32_throughput_benchmark"
        default n
        help
            Run one deterministic Posit32 GEMM MxK times KxN benchmark.
            The runner reports cycle-level throughput and verifies every
            output against the SoftPosit MAC recurrence.

    endchoice

if MATRIX_GEMM_P32_BENCHMARK || LLM_P32_MAC_WORKLOAD

choice
    prompt "P32 MNK test shape"
    default MATRIX_GEMM_P32_PRESET_TAIL_K2

config MATRIX_GEMM_P32_PRESET_TAIL_K1
    bool "Tail K=1: M=2, N=3, K=1"

config MATRIX_GEMM_P32_PRESET_TAIL_K2
    bool "Tail K=2: M=2, N=3, K=2"

config MATRIX_GEMM_P32_PRESET_TAIL_K3
    bool "Tail K=3: M=2, N=3, K=3"

config MATRIX_GEMM_P32_PRESET_TAIL_K4
    bool "Full lane K=4: M=2, N=3, K=4"

config MATRIX_GEMM_P32_PRESET_TAIL_K5
    bool "Tail K=5: M=2, N=3, K=5"

config MATRIX_GEMM_P32_PRESET_SQUARE_16
    bool "Square small: M=16, N=16, K=16"

config MATRIX_GEMM_P32_PRESET_SQUARE_32_K63
    bool "Square tail: M=32, N=32, K=63"

config MATRIX_GEMM_P32_PRESET_SQUARE_32_K64
    bool "Square full lane: M=32, N=32, K=64"

config MATRIX_GEMM_P32_PRESET_SQUARE_32_K65
    bool "Square tail: M=32, N=32, K=65"

config MATRIX_GEMM_P32_PRESET_GEMV_ROW
    bool "GEMV row: M=1, N=128, K=256"

config MATRIX_GEMM_P32_PRESET_GEMV_COLUMN
    bool "GEMV column: M=128, N=1, K=256"

config MATRIX_GEMM_P32_PRESET_WIDE
    bool "Wide: M=16, N=128, K=64"

config MATRIX_GEMM_P32_PRESET_TALL
    bool "Tall: M=128, N=16, K=64"

config MATRIX_GEMM_P32_PRESET_CUBE_64
    bool "Cube medium: M=64, N=64, K=64"

config MATRIX_GEMM_P32_PRESET_CUBE_128
    bool "Cube large: M=128, N=128, K=128"

endchoice

config MATRIX_GEMM_P32_M
    int
    range 1 4096
    default 2 if MATRIX_GEMM_P32_PRESET_TAIL_K1 || MATRIX_GEMM_P32_PRESET_TAIL_K2 || MATRIX_GEMM_P32_PRESET_TAIL_K3 || MATRIX_GEMM_P32_PRESET_TAIL_K4 || MATRIX_GEMM_P32_PRESET_TAIL_K5
    default 16 if MATRIX_GEMM_P32_PRESET_SQUARE_16 || MATRIX_GEMM_P32_PRESET_WIDE
    default 32 if MATRIX_GEMM_P32_PRESET_SQUARE_32_K63 || MATRIX_GEMM_P32_PRESET_SQUARE_32_K64 || MATRIX_GEMM_P32_PRESET_SQUARE_32_K65
    default 1 if MATRIX_GEMM_P32_PRESET_GEMV_ROW
    default 128 if MATRIX_GEMM_P32_PRESET_GEMV_COLUMN || MATRIX_GEMM_P32_PRESET_TALL || MATRIX_GEMM_P32_PRESET_CUBE_128
    default 64 if MATRIX_GEMM_P32_PRESET_CUBE_64

config MATRIX_GEMM_P32_N
    int
    range 1 4096
    default 3 if MATRIX_GEMM_P32_PRESET_TAIL_K1 || MATRIX_GEMM_P32_PRESET_TAIL_K2 || MATRIX_GEMM_P32_PRESET_TAIL_K3 || MATRIX_GEMM_P32_PRESET_TAIL_K4 || MATRIX_GEMM_P32_PRESET_TAIL_K5
    default 16 if MATRIX_GEMM_P32_PRESET_SQUARE_16 || MATRIX_GEMM_P32_PRESET_TALL
    default 32 if MATRIX_GEMM_P32_PRESET_SQUARE_32_K63 || MATRIX_GEMM_P32_PRESET_SQUARE_32_K64 || MATRIX_GEMM_P32_PRESET_SQUARE_32_K65
    default 128 if MATRIX_GEMM_P32_PRESET_GEMV_ROW || MATRIX_GEMM_P32_PRESET_WIDE || MATRIX_GEMM_P32_PRESET_CUBE_128
    default 1 if MATRIX_GEMM_P32_PRESET_GEMV_COLUMN
    default 64 if MATRIX_GEMM_P32_PRESET_CUBE_64

config MATRIX_GEMM_P32_K
    int
    range 1 4096
    default 1 if MATRIX_GEMM_P32_PRESET_TAIL_K1
    default 2 if MATRIX_GEMM_P32_PRESET_TAIL_K2
    default 3 if MATRIX_GEMM_P32_PRESET_TAIL_K3
    default 4 if MATRIX_GEMM_P32_PRESET_TAIL_K4
    default 5 if MATRIX_GEMM_P32_PRESET_TAIL_K5
    default 16 if MATRIX_GEMM_P32_PRESET_SQUARE_16
    default 63 if MATRIX_GEMM_P32_PRESET_SQUARE_32_K63
    default 64 if MATRIX_GEMM_P32_PRESET_SQUARE_32_K64
    default 65 if MATRIX_GEMM_P32_PRESET_SQUARE_32_K65
    default 256 if MATRIX_GEMM_P32_PRESET_GEMV_ROW || MATRIX_GEMM_P32_PRESET_GEMV_COLUMN
    default 64 if MATRIX_GEMM_P32_PRESET_WIDE || MATRIX_GEMM_P32_PRESET_TALL || MATRIX_GEMM_P32_PRESET_CUBE_64
    default 128 if MATRIX_GEMM_P32_PRESET_CUBE_128

endif

if LLM_P32_MAC_WORKLOAD

choice
    prompt "LLM P32 MAC trace profile"
    default LLM_P32_PROFILE_QWEN3_0_6B

config LLM_P32_PROFILE_QWEN3_0_6B
    bool "Qwen3-0.6B (dense baseline)"

config LLM_P32_PROFILE_GEMMA3_1B
    bool "Gemma 3 1B (dense)"

config LLM_P32_PROFILE_PHI4_MINI
    bool "Phi-4-mini-instruct (dense)"

endchoice

config LLM_P32_MAC_TRACE_DIR
    string "LLM P32 MAC trace directory"
    default "/tmp/qwen3-0.6b-p32-trace" if LLM_P32_PROFILE_QWEN3_0_6B
    default "/tmp/gemma-3-1b-p32-trace" if LLM_P32_PROFILE_GEMMA3_1B
    default "/tmp/phi-4-mini-p32-trace" if LLM_P32_PROFILE_PHI4_MINI
    help
        Directory produced by tools/export_llm_p32_trace.py. The runner never
        falls back to a fixture and make run reports an error when this path
        is invalid.

endif

endmenu

config SAMPLE_TEST
    bool "manually_sample_test"
    default n
```
